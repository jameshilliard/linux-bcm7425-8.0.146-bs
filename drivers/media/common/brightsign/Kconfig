## drivers/media/common/brightsign/Kconfig
```kconfig
config VIDEO_BS_TV
	tristate "BrightSign TV support"
	depends on MEDIA_DIGITAL_TV_SUPPORT && I2C
	select MEDIA_TUNER_XC5000
	select DVB_LGDT3305
	---help---
	  This is a video4linux driver for BrightSign.
```

## drivers/soc/brightsign/Kconfig
```kconfig
config BRIGHTSIGN_TETSUO_FPGA
       bool "Enable BrightSign Tetsuo FPGA sound driver"
       depends on SPI
       depends on SOUND
       default n

config BRIGHTSIGN_GPIO_MUX
       bool "Enable BrightSign GPIO alternate function multiplexing"
       default n

if PWM
config BRIGHTSIGN_POE_LOAD
       bool "Enable BrightSign Power over Ethernet load driver"
       default y
endif
```

## kernel/Kconfig.timedoctor
```kconfig
config TIME_DOCTOR
        tristate "Enable Time Doctor output"
	default n
	help
	  Collect information on tasks and interrupts

config TIME_DOCTOR_SAMPLES
	int "Number of Time Doctor samples to be stored"
	depends on TIME_DOCTOR
	default 131072
	help
	  Maximum number of time doctor samples to be stored

config TIME_DOCTOR_PRESERVE_OVER_REBOOT
        bool "Preserve contents of time doctor buffer over a reboot"
	depends on TIME_DOCTOR = y
	default n

config TIME_DOCTOR_AUTO_START
        bool "Automatically start time doctor in wrapping mode at boot"
	depends on TIME_DOCTOR
	default n
```
